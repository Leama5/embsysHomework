## prj.conf
```kconfig
CONFIG_HEAP_MEM_POOL_SIZE=1024
CONFIG_TIMING_FUNCTIONS=y
CONFIG_GPIO=y
CONFIG_SERIAL=y
CONFIG_CONSOLE=y
CONFIG_UART_CONSOLE=y
CONFIG_PRINTK=y
```

## src/main.c
```c
#include <zephyr/kernel.h>
#include <zephyr/sys/printk.h>
#include <zephyr/device.h>
#include <zephyr/drivers/gpio.h>
#include <zephyr/drivers/uart.h>
#include <zephyr/timing/timing.h>
#include <stdlib.h>
#include <stdio.h>
#include <string.h>
#include <ctype.h>

/****************************
 * Remember to add line:
 * CONFIG_HEAP_MEM_POOL_SIZE=1024
 * CONFIG_TIMING_FUNCTIONS=y
 * to prj.conf
 ****************************/
// Yhteensä laskettuna kaikki tehtävät olisi 11 pistettä!
//Vko 3 lisätehtävä T merkillä toistaa edellisen 
//vko 6 perustehtävä +1 suoritus lisättyjä aikamerkkijonon testejä.
 // vko 3 lisätehtävä while loopit poistettu valotaskeista
 //vko 5 perustehtävät ja +1p koska parserissa pituuden tarkastus, Nullin tarkastus, 0sekunnin tarkastus sekä pelkät nunmerot.
 //vko 4 tavoitteena tehdä lisätehtävät myöhemmin
 //Vko 4 Perustehtävä tehty siten että valotaskien ajat sekä sekvenssin ajat lasketaan. Kommenteissa muut printit paitsi taskien ajat
  //vko 3 yritin tehdä sekvenssiin ajastuksen, mutta ei toimi tällä terminaalilla niin jatkoin aiemmalla koodilla vko4 tehtäviin.
 //Vko 3 Perustehtävät tehtynä tavoitteena tehdä myös lisää lisäominaisuuksia tulevina viikkoina 
#define COMMAND_OK          0
#define TIME_LEN_ERROR      -1
#define TIME_ARRAY_ERROR    -2
#define TIME_VALUE_ERROR    -3
#define TIME_ZERO_ERROR    -4
#define TIME_NUMBER_ERROR  -5
//Timer Initializations
struct k_timer timer;
void timer_handler(struct k_timer *timer_id);
//Parser
int time_parse(char *command);
K_SEM_DEFINE(timer_sem, 0, 1);


// Led pin configurations
static const struct gpio_dt_spec red = GPIO_DT_SPEC_GET(DT_ALIAS(led0), gpios);
static const struct gpio_dt_spec green = GPIO_DT_SPEC_GET(DT_ALIAS(led1), gpios);
static const struct gpio_dt_spec blue = GPIO_DT_SPEC_GET(DT_ALIAS(led2), gpios);


#define BUTTON_0 DT_ALIAS(sw0)
#define BUTTON_1 DT_ALIAS(sw1)
#define BUTTON_2 DT_ALIAS(sw2)
#define BUTTON_3 DT_ALIAS(sw3)
#define BUTTON_4 DT_ALIAS(sw4)
// #define BUTTON_1 DT_ALIAS(sw1)
static const struct gpio_dt_spec button_0 = GPIO_DT_SPEC_GET_OR(BUTTON_0, gpios, {0});
static struct gpio_callback button_0_data;
static const struct gpio_dt_spec button_1 = GPIO_DT_SPEC_GET_OR(BUTTON_1, gpios, {0});
static struct gpio_callback button_1_data;
static const struct gpio_dt_spec button_2 = GPIO_DT_SPEC_GET_OR(BUTTON_2, gpios, {0});
static struct gpio_callback button_2_data;
static const struct gpio_dt_spec button_3 = GPIO_DT_SPEC_GET_OR(BUTTON_3, gpios, {0});
static struct gpio_callback button_3_data;
static const struct gpio_dt_spec button_4 = GPIO_DT_SPEC_GET_OR(BUTTON_4, gpios, {0});
static struct gpio_callback button_4_data;
// Thread initializations
#define STACKSIZE 500
#define PRIORITY 5

static char previous_sequence[20] = {0};

void yellow_flash_task(void *, void *, void *);


int button1=0;
int button2=0;
int button3=0;
int button4=0;

void red_led_work_handler(struct k_work *work);
void yellow_led_work_handler(struct k_work *work);
void green_led_work_handler(struct k_work *work);

struct k_work red_work;
struct k_work yellow_work;
struct k_work green_work;
// UART initialization
#define UART_DEVICE_NODE DT_CHOSEN(zephyr_shell_uart)
static const struct device *const uart_dev = DEVICE_DT_GET(UART_DEVICE_NODE);

//Condition Variables
K_MUTEX_DEFINE(release_mutex);
K_CONDVAR_DEFINE(release_signal);

// Create dispatcher FIFO buffer
K_FIFO_DEFINE(dispatcher_fifo);

// FIFO dispatcher data type
struct data_t {
	/*************************
	// Add fifo_reserved below
	*************************/
	void *fifo_reserved;
	char msg[20];
};

void red_led_work_handler(struct k_work *work)
{

	timing_t red_start_time =timing_counter_get();

	gpio_pin_set_dt(&red,1);
	k_sleep(K_SECONDS(1));
	gpio_pin_set_dt(&red,0);
	
	timing_t red_end_time = timing_counter_get();
	uint64_t timing_us= timing_cycles_to_ns(timing_cycles_get(&red_start_time, &red_end_time));
	printk("Red task: %llu us\n", timing_us / 1000);
	k_condvar_broadcast(&release_signal);
}
void yellow_led_work_handler(struct k_work *work)
{
	timing_t yellow_start_time = timing_counter_get();

	gpio_pin_set_dt(&red, 1);
	gpio_pin_set_dt(&green, 1);
	k_sleep(K_SECONDS(1));
	gpio_pin_set_dt(&red, 0);
	gpio_pin_set_dt(&green, 0);

	timing_t yellow_end_time = timing_counter_get();
	uint64_t timing_us = timing_cycles_to_ns(timing_cycles_get(&yellow_start_time, &yellow_end_time));
	printk("Yellow task: %llu us\n", timing_us / 1000);

	k_condvar_broadcast(&release_signal);
}

void green_led_work_handler(struct k_work *work)
{
	timing_t green_start_time = timing_counter_get();

	gpio_pin_set_dt(&green, 1);
	k_sleep(K_SECONDS(1));
	gpio_pin_set_dt(&green, 0);

	timing_t green_end_time = timing_counter_get();
	uint64_t timing_us = timing_cycles_to_ns(timing_cycles_get(&green_start_time, &green_end_time));
	printk("Green task: %llu us\n", timing_us / 1000);

	k_condvar_broadcast(&release_signal);
}

void button_0_handler(const struct device *dev, struct gpio_callback *cb, uint32_t pins)
{
	printk("Button pressed\n");
	//ei tapahdu mitään tällä hetkellä

}
void button_1_handler(const struct device *dev, struct gpio_callback *cb, uint32_t pins)
{
	printk("1 Button pressed\n");
	//lähetetään signaali red valotaskille
	k_work_submit(&red_work);
}
void button_2_handler(const struct device *dev, struct gpio_callback *cb, uint32_t pins)
{
	printk("2 button pressed \n");
	k_work_submit(&yellow_work);

}
void button_3_handler(const struct device *dev, struct gpio_callback *cb, uint32_t pins)
{
	printk("3 Button pressed\n");
	k_work_submit(&green_work);
}
void button_4_handler(const struct device *dev, struct gpio_callback *cb, uint32_t pins)
{
	printk("4 Button pressed\n");
	if (button4 == 0){
		button4=1;
	}
	else
		button4=0;

}
/********************
 * init UART
 */
int init_uart(void) {
	// UART initialization
	if (!device_is_ready(uart_dev)) {
		return 1;
	} 
	return 0;
}

// Button initialization
int init_button() {
	static const struct gpio_dt_spec buttons[] = {
    button_0,
    button_1,
    button_2,
    button_3,
    button_4
	};
	int ret;

	for (int i=0; i<5; i++){
		if (!gpio_is_ready_dt(&buttons[i])) {
			printk("Error: button %d is not ready\n", i);
			return -1;
		}
		ret = gpio_pin_configure_dt(&buttons[i], GPIO_INPUT);
		if (ret != 0) {
				printk("Error: failed to configure interrupt for button %d\n", i);
				return -1;
		}
		ret = gpio_pin_interrupt_configure_dt(&buttons[i], GPIO_INT_EDGE_TO_ACTIVE);
		if (ret != 0) {
			printk("Error: failed to configure interrupt for button %d\n",i);
			return -1;
		}
	}

	gpio_init_callback(&button_0_data, button_0_handler, BIT(button_0.pin));
	gpio_add_callback(button_0.port, &button_0_data);
	printk("Set up button 0 ok\n");
	gpio_init_callback(&button_1_data, button_1_handler, BIT(button_1.pin));
	gpio_add_callback(button_1.port, &button_1_data);
	printk("Set up button 1 ok\n");
	gpio_init_callback(&button_2_data, button_2_handler, BIT(button_2.pin));
	gpio_add_callback(button_2.port, &button_2_data);
	printk("Set up button 2 ok\n");
	gpio_init_callback(&button_3_data, button_3_handler, BIT(button_3.pin));
	gpio_add_callback(button_3.port, &button_3_data);
	printk("Set up button 3 ok\n");
	gpio_init_callback(&button_4_data, button_4_handler, BIT(button_4.pin));
	gpio_add_callback(button_4.port, &button_4_data);
	printk("Set up button 4 ok\n");
	return 0;
}

// Initialize leds
int  init_led() {

	// Led pin initialization
	int ret = gpio_pin_configure_dt(&red, GPIO_OUTPUT_ACTIVE);
	if (ret < 0) {
		printk("Error: Red led configure failed\n");		
		return ret;
	}
	// set red led off
	gpio_pin_set_dt(&red,0);

	ret = gpio_pin_configure_dt(&green, GPIO_OUTPUT_ACTIVE);
	if (ret < 0) {
		printk("Error: Green led configure failed\n");		
		return ret;
	}
	// set green led off
	gpio_pin_set_dt(&green,0);

	ret = gpio_pin_configure_dt(&blue, GPIO_OUTPUT_ACTIVE);
	if (ret < 0) {
		printk("Error: Blue led configure failed\n");		
		return ret;
	}
	// set blue led off
	gpio_pin_set_dt(&blue,0);
	

	printk("Leds initialized ok\n");
	
	return 0;
}

/********************
 * Main task
 */
int main(void)
{
        timing_init();
        timing_start();
	int ret = init_uart();
	if (ret != 0) {
		printk("UART initialization failed!\n");
		return ret;
	}
	init_led();
	init_button();
	//Timer initialization
	k_timer_init(&timer, timer_handler,NULL);
    
	k_work_init(&red_work, red_led_work_handler);
	k_work_init(&yellow_work, yellow_led_work_handler);
	k_work_init(&green_work, green_led_work_handler);

	return 0;
}

/********************
 * UART task
 */
static void uart_task(void *unused1, void *unused2, void *unused3)
{
	// Received character from UART
	char rc=0;
	// Message from UART
	char uart_msg[20];
	
	int uart_msg_cnt = 0;
	memset(uart_msg,0,20);

	while (true) {
		// Ask UART if data available
		if (uart_poll_in(uart_dev,&rc) == 0) {
			//printk("Received: %c\n",rc);
			// If character is not newline, add to UART message buffer
			if (rc=='\n' ||rc=='\r'|| rc =='X') {
				if (uart_msg_cnt>0){
					uart_msg[uart_msg_cnt]='\0';
					//printk("UART msg: %s\n", uart_msg);
					struct data_t *buf = k_malloc(sizeof(struct data_t));

					if (buf == NULL) {
						return;
					}
					if (uart_msg[0]=='R'||
						uart_msg[0]=='Y'||
						uart_msg[0]=='G'||
						uart_msg[0]=='T' ){
							// Copy UART message to dispatcher data
						snprintf(buf->msg, 20, "%s", uart_msg);

						k_fifo_put(&dispatcher_fifo, buf);
						}
					else{
				
						int ret =time_parse(uart_msg);
						//printk("Parsed time = %d \n", ret);

						if (ret>0){
						
						k_timer_start(&timer, K_SECONDS(ret), K_NO_WAIT);
						//printk("Timer started");
						printk("%dX", ret);
						}
						else if(ret == TIME_VALUE_ERROR){
							printk("-3X");
						}
						else if(ret == TIME_LEN_ERROR){
							printk("-1X"); 
						}
						else if(ret == TIME_ARRAY_ERROR){
							printk("-2X");
						}
						else if(ret == TIME_ZERO_ERROR){
							printk("-4X");
						}
						else if (ret == TIME_NUMBER_ERROR){
							printk("-5X");
						}
					}	
				}
				// Clear UART receive buffer
			uart_msg_cnt = 0;
			memset(uart_msg,0,20);
			}
			else {
				if (uart_msg_cnt < sizeof(uart_msg)-1){
					uart_msg[uart_msg_cnt] = rc;
					uart_msg_cnt++;
				}				
				
			}
		}
		k_msleep(10);
	}
	//return;
}

// time format: HHMMSS (6 characters)
int time_parse(char *time) {
	
	// how many seconds, default returns error
	int seconds = TIME_LEN_ERROR;

	// TODO: Check that string is not null
	if (time == NULL) {
		return TIME_ARRAY_ERROR;
	}

	if (strlen(time) != 6) {
    	return TIME_LEN_ERROR;
	}
	for (int i=0; i<6; i++){
		if (!isdigit((unsigned char)time[i])){
			return TIME_NUMBER_ERROR;
		}
	}

		// Parse values from time string
		// For example: 124033 -> 12hour 40min 33sec
		int values[3];
		values[2] = atoi(time+4); // seconds
		time[4] = 0;
		values[1] = atoi(time+2); // minutes
		time[2] = 0;
		values[0] = atoi(time); // hours
		// Now you have:
		// values[0] hour
		// values[1] minute
		// values[2] second

		// TODO: Add boundary check time values: below zero or above limit not allowed
		// limits are 59 for minutes, 23 for hours, etc
		if (values[2]>=0 && values[2]<=59 && values[1]>=0 && values[1]<=59 && values[0]>= 0 && values[0]<=23){

		// TODO: Calculate return value from the parsed minutes and seconds
		// Otherwise error will be returned!
		// seconds = ...
		//hours values[0]*3600+
		//only minutes and seconds 
			seconds= values[0]*3600+values[1]*60+ values[2];
			if (seconds==0){
				return TIME_ZERO_ERROR;
			}
			return seconds;
		}
		else{
			return TIME_VALUE_ERROR;
		}
}
/********************
 * Dispatcher task
 */
static void dispatcher_task(void *unused1, void *unused2, void *unused3)
{
	while (true) {
		// Receive dispatcher data from uart_task fifo
		struct data_t *rec_item = k_fifo_get(&dispatcher_fifo, K_FOREVER);
		char sequence[20];
		memcpy(sequence,rec_item->msg,20);
		k_free(rec_item);

		if (sequence[0] == 'T' && sequence[1] == '\0') {
			if (previous_sequence[0] != '\0') {
				snprintf(sequence, 20, "%sT", previous_sequence);
				printk("vanha sekvenssi: %s\n", sequence);
			} else {
				printk("Dispatcher: Ei edellistä sekvenssiä muistissa!\n");
				continue; 
			}
		} else {
			int i = 0;
			int save_idx=0;
			memset(previous_sequence, 0, 20);
			while (sequence[i] != '\0' && i < 19) {
				previous_sequence[i] = sequence[i];
				if (sequence[i] == 'R' || sequence[i] == 'Y' || sequence[i] == 'G') {
					previous_sequence[save_idx] = sequence[i];
					save_idx++;
				}
				i++;
			}
		}

		printk("Dispatcher: %s\n", sequence);
		int cnt=0;
        //Ajastin
        timing_t sequence_start_time=timing_counter_get();
		k_mutex_lock(&release_mutex, K_FOREVER);

		//tulostetaan merkki kerrallaan
		while (sequence[cnt] != 0){
			if(sequence[cnt] == 'R'){
				//printk("Red");
				//lähetetään signaali red valotaskille
				k_work_submit(&red_work);
				k_condvar_wait(&release_signal, &release_mutex, K_FOREVER);
		
			}
			else if (sequence[cnt] == 'Y'){
				//printk("Yellow");
				k_work_submit(&yellow_work);
				k_condvar_wait(&release_signal, &release_mutex, K_FOREVER);
		
			}
			else if (sequence[cnt] == 'G'){
				//printk("Green");
				k_work_submit(&green_work);
				k_condvar_wait(&release_signal, &release_mutex, K_FOREVER);
			}
			// LISÄTTY: Jos kohdataan 'T', aloitetaan sekvenssi alusta
			else if (sequence[cnt] == 'T'){
				sequence[cnt] = '\0';
				cnt = 0; // Asetetaan indeksi takaisin alkuun
				continue; // Hypätään suoraan loopin alkuun, ohittaen cnt++
			}
			cnt++;
        }
		k_mutex_unlock(&release_mutex);
        timing_t sequence_end_time=timing_counter_get();
        uint64_t timing_us = timing_cycles_to_ns(timing_cycles_get(&sequence_start_time, &sequence_end_time));
	    //printk("Sequence time: %lld\n", timing_us/1000);
    }
}

void timer_handler(struct k_timer *timer_id){
	//printk("Timer expired");
	//k_condvar_broadcast(&red_signal);
	k_sem_give(&timer_sem);
	
}
void timer_led_task(void *, void *, void *){
	while (true) {

        k_sem_take(&timer_sem, K_FOREVER);
			// 1. set led on 
		gpio_pin_set_dt(&red,1);
		//printk("Red on\n");
			// 2. sleep for 2 seconds
		k_sleep(K_SECONDS(1));
			// 3. set led off
		gpio_pin_set_dt(&red,0);
		//printk("Red off\n");
    }
}
void yellow_flash_task(void *, void *, void *){
	while (true){
		if (button4 ==1){
		gpio_pin_set_dt(&red,1);
		gpio_pin_set_dt(&green,1);
		k_sleep(K_SECONDS(1));
		gpio_pin_set_dt(&red,0);
		gpio_pin_set_dt(&green,0);
		k_sleep(K_SECONDS(1));
		}
		else{
			k_msleep(10);
		}
	}
}

K_THREAD_DEFINE( yellow_flash_thread,STACKSIZE,yellow_flash_task,NULL,NULL,NULL,PRIORITY, 0, 0);
K_THREAD_DEFINE(dis_thread,STACKSIZE,dispatcher_task,NULL,NULL,NULL,PRIORITY,0,0);
K_THREAD_DEFINE(uart_thread,STACKSIZE,uart_task,NULL,NULL,NULL,PRIORITY,0,0);
K_THREAD_DEFINE(timer_led_thread,STACKSIZE,timer_led_task,NULL,NULL,NULL,PRIORITY,0,0);
```
